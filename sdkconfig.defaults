## sdkconfig.defaults
```kconfig
CONFIG_ESPTOOLPY_FLASHSIZE_4MB=y

# Custom partition table — ~3.9MB for app (no OTA)
CONFIG_PARTITION_TABLE_CUSTOM=y
CONFIG_PARTITION_TABLE_CUSTOM_FILENAME="partitions.csv"

# Lower brownout threshold from 2.44V to 2.27V for USB power stability
CONFIG_ESP_BROWNOUT_DET_LVL_SEL_5=y

# HTTPS certificate bundle for Gemini API
CONFIG_MBEDTLS_CERTIFICATE_BUNDLE=y
CONFIG_MBEDTLS_CERTIFICATE_BUNDLE_DEFAULT_FULL=y
```

## src/Kconfig.projbuild
```kconfig
menu "Voice Assistant Configuration"

    menu "WiFi Settings"
        config WIFI_SSID
            string "WiFi SSID"
            default "my_ssid"
            help
                SSID of your WiFi network.

        config WIFI_PASSWORD
            string "WiFi Password"
            default "my_password"
            help
                Password of your WiFi network.
    endmenu

    menu "API Keys"
        config GEMINI_API_KEY
            string "Gemini API Key"
            default ""
            help
                Google Gemini API key for LLM queries.

        config CLOUD_TTS_API_KEY
            string "Google Cloud TTS API Key"
            default ""
            help
                Google Cloud Text-to-Speech API key (from Cloud Console).
    endmenu

    choice TEST_MODE_SELECT
        prompt "Audio test mode"
        default TEST_LOOPBACK
        help
            Select the audio test mode

        config TEST_MIC
            bool "Microphone only (RMS to serial)"
        config TEST_SPEAKER
            bool "Speaker only (1kHz sine)"
        config TEST_LOOPBACK
            bool "Loopback (mic -> speaker)"
    endchoice

endmenu
```
